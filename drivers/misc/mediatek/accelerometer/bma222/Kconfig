## drivers/misc/mediatek/accelerometer/bma222/Kconfig
```kconfig
config MTK_BMA222
	bool "MTK_BMA222 for MediaTek package"
	default n
	help
	  It support different accelerometer sensor.
          If this option is set,
	  it will support
          MTK_BMA222 Accelerometer.

config BMA222_LOWPASS
	bool "MTK_BMA222 for Mediatek package"
	default n
	help
	Say Y here if you have MTK_BMA222 touch panel BMA222_LOWPASS.

	If unsure, say N.

	To compile this dirver as a module, choose M here: the
	module will be called.

config CUSTOM_KERNEL_SENSORHUB
	bool "MTK_BMA222 for Mediatek package"
	default n
	help
	Say Y here if you have MTK_BMA222 touch panel CUSTOM_KERNEL_SENSORHUB.

	If unsure, say N.

	To compile this dirver as a module, choose M here: the
	module will be called.
```
